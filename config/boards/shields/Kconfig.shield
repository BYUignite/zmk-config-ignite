## config/boards/shields/Kconfig.shield
```kconfig
config SHIELD_IGNITE_LEFT
    def_bool $(shields_list_contains,ignite_left)

config SHIELD_IGNITE_RIGHT
    def_bool $(shields_list_contains,ignite_right)
```

## config/boards/shields/ignite/Kconfig.defconfig
```kconfig
if SHIELD_IGNITE_LEFT

config ZMK_KEYBOARD_NAME
    default "Ignite"

config ZMK_SPLIT_ROLE_CENTRAL
    default y

endif

if SHIELD_IGNITE_LEFT || SHIELD_IGNITE_RIGHT

config ZMK_SPLIT
    default y

endif
```
